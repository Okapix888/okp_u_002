
#include <behaviors.dtsi>
#include <dt-bindings/zmk/keys.h>

#include "../../../config/keymap.keymap"

#include <input/processors.dtsi>

// &trackball_listener {
//     input-processors = <&zip_temp_layer 4 10000>;
// };
